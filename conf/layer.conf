## conf/layer.conf
```bitbake
# We have a conf and classes directory, add to BBPATH
BBPATH .= ":${LAYERDIR}"

# We have recipes-* directories, add to BBFILES
BBFILES += "${LAYERDIR}/recipes-*/*/*.bb \
            ${LAYERDIR}/recipes-*/*/*.bbappend"

BBFILE_COLLECTIONS += "meta-wifi-credentials"
BBFILE_PATTERN_meta-wifi-credentials = "^${LAYERDIR}/"
BBFILE_PRIORITY_meta-wifi-credentials = "99"

LAYERDEPENDS_meta-wifi-credentials = "core"
LAYERSERIES_COMPAT_meta-wifi-credentials = "thud"
```

## connman/conf/layer.conf
```bitbake
# We have a conf and classes directory, add to BBPATH
BBPATH .= ":${LAYERDIR}"

# We have recipes-* directories, add to BBFILES
BBFILES += "${LAYERDIR}/recipes-*/*/*.bb \
            ${LAYERDIR}/recipes-*/*/*.bbappend"

BBFILE_COLLECTIONS += "meta-wifi-credentials-connman"
BBFILE_PATTERN_meta-wifi-credentials-connman = "^${LAYERDIR}/"
BBFILE_PRIORITY_meta-wifi-credentials-connman = "99"

LAYERDEPENDS_meta-wifi-credentials-connman = "core"
LAYERSERIES_COMPAT_meta-wifi-credentials-connman = "thud"
```

## systemd-networkd/conf/layer.conf
```bitbake
# We have a conf and classes directory, add to BBPATH
BBPATH .= ":${LAYERDIR}"

# We have recipes-* directories, add to BBFILES
BBFILES += "${LAYERDIR}/recipes-*/*/*.bb \
            ${LAYERDIR}/recipes-*/*/*.bbappend"

BBFILE_COLLECTIONS += "meta-wifi-credentials-systemd"
BBFILE_PATTERN_meta-wifi-credentials-systemd = "^${LAYERDIR}/"
BBFILE_PRIORITY_meta-wifi-credentials-systemd = "99"

LAYERDEPENDS_meta-wifi-credentials-systemd = "core"
LAYERSERIES_COMPAT_meta-wifi-credentials-systemd = "thud"
```

## sysvinit/conf/layer.conf
```bitbake
# We have a conf and classes directory, add to BBPATH
BBPATH .= ":${LAYERDIR}"

# We have recipes-* directories, add to BBFILES
BBFILES += "${LAYERDIR}/recipes-*/*/*.bb \
            ${LAYERDIR}/recipes-*/*/*.bbappend"

BBFILE_COLLECTIONS += "meta-wifi-credentials-sysvinit"
BBFILE_PATTERN_meta-wifi-credentials-sysvinit = "^${LAYERDIR}/"
BBFILE_PRIORITY_meta-wifi-credentials-sysvinit = "99"

LAYERDEPENDS_meta-wifi-credentials-sysvinit = "core"
LAYERSERIES_COMPAT_meta-wifi-credentials-sysvinit = "thud"
```
